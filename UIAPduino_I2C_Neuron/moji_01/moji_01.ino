/*
 * Project: UIAPduino_Font_Installer
 * Version: 0.03
 * Author: yas / Gemini
 * Date: 2026-04-03
 * Description: Phase 1 Font Installer for EEPROM (ASCII 32 to 126).
 * History:
 * 0.01 - Initial creation. Writes 5x7 ASCII font data to 24LC512 EEPROM starting at 0x0100.
 * 0.02 - Phase 2 Katakana installer. Writes 63 characters (5 bytes each) starting at 0x02DB.
 * 0.03 - Re-execution of Phase 1 to repair font data collision.
 */

#include <Arduino.h>

#define SOFT_SDA 6 // PC6
#define SOFT_SCL 7 // PC7
#define EEPROM_ADDR 0x50

void neuron_delay_nop(volatile uint32_t count) { while(count--) __asm__("nop"); }

void uart_init() {
    RCC->APB2PCENR |= (1 << 14);
    GPIOD->CFGLR &= ~((0xF << 20) | (0xF << 24));
    GPIOD->CFGLR |=  ((0x9 << 20) | (0x4 << 24));
    USART1->BRR = (48000000 + 115200 / 2) / 115200; 
    USART1->CTLR1 = (1 << 13) | (1 << 3) | (1 << 2); 
}
void uart_write(uint8_t data) { while (!(USART1->STATR & (1 << 7))); USART1->DATAR = data; }
void uart_print(const char* str) { while(*str) uart_write(*str++); }

void soft_i2c_start() {
    GPIOC->BSHR = (1 << SOFT_SDA); neuron_delay_nop(5);
    GPIOC->BSHR = (1 << SOFT_SCL); neuron_delay_nop(5);
    GPIOC->BSHR = (1 << (SOFT_SDA + 16)); neuron_delay_nop(5);
    GPIOC->BSHR = (1 << (SOFT_SCL + 16)); neuron_delay_nop(5);
}
void soft_i2c_stop() {
    GPIOC->BSHR = (1 << (SOFT_SDA + 16)); neuron_delay_nop(5);
    GPIOC->BSHR = (1 << SOFT_SCL); neuron_delay_nop(5);
    GPIOC->BSHR = (1 << SOFT_SDA);
}
void soft_i2c_write(uint8_t data) {
    for(int i=0; i<8; i++) {
        if(data & 0x80) GPIOC->BSHR = (1 << SOFT_SDA);
        else GPIOC->BSHR = (1 << (SOFT_SDA + 16));
        neuron_delay_nop(5);
        GPIOC->BSHR = (1 << SOFT_SCL); neuron_delay_nop(5);
        GPIOC->BSHR = (1 << (SOFT_SCL + 16));
        data <<= 1;
    }
    GPIOC->BSHR = (1 << SOFT_SDA); neuron_delay_nop(5);
    GPIOC->BSHR = (1 << SOFT_SCL); neuron_delay_nop(5);
    GPIOC->BSHR = (1 << (SOFT_SCL + 16));
}

void eeprom_write_byte(uint16_t addr, uint8_t data) {
    soft_i2c_start(); 
    soft_i2c_write((EEPROM_ADDR << 1) | 0);
    soft_i2c_write((uint8_t)(addr >> 8)); 
    soft_i2c_write((uint8_t)(addr & 0xFF));
    soft_i2c_write(data); 
    soft_i2c_stop(); 
    delay(5); // 5ms EEPROM write cycle delay
}

// ASCII 32 (' ') to 126 ('~') : 95 characters x 5 bytes
const uint8_t font_data[95][5] = {
    {0x00, 0x00, 0x00, 0x00, 0x00}, // 32  
    {0x00, 0x00, 0x5F, 0x00, 0x00}, // 33 !
    {0x00, 0x07, 0x00, 0x07, 0x00}, // 34 "
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    {0x10, 0x08, 0x08, 0x10, 0x08}  // 126 ~
};

void setup() {
    RCC->APB2PCENR |= RCC_AFIOEN | RCC_IOPCEN | RCC_IOPDEN;
    GPIOC->CFGLR &= ~((0xF << 24) | (0xF << 28));
    GPIOC->CFGLR |=  ((0x5 << 24) | (0x5 << 28)); // PC6, PC7 Out
    
    uart_init();
    uart_print("\r\n--- Font Installer Phase 1 (ASCII) ---\r\n");
    uart_print("Starting EEPROM Write to 0x0100...\r\n");

    uint16_t eeprom_addr = 0x0100;
    
    for (int i = 0; i < 95; i++) {
        for (int j = 0; j < 5; j++) {
            eeprom_write_byte(eeprom_addr, font_data[i][j]);
            eeprom_addr++;
        }
        if (i % 10 == 0) uart_print("."); // Progress dot
    }

    uart_print("\r\nWrite Complete! ASCII 32-126 Installed.\r\n");
    uart_print("You can now flash Phase 2 or the OS.\r\n");
}

void loop() {
    delay(1000);
}