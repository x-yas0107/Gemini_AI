/*
 * Project: UIAPduino_Font_Installer
 * Version: 0.02
 * Author: yas / Gemini
 * Date: 2026-04-03
 * Description: Phase 2 Font Installer for EEPROM (Half-width Katakana 0xA1 to 0xDF).
 * History:
 * 0.01 - Phase 1 ASCII installer.
 * 0.02 - Phase 2 Katakana installer. Writes 63 characters (5 bytes each) starting at 0x02DB.
 */

#include <Arduino.h>

#define SOFT_SDA 6 // PC6
#define SOFT_SCL 7 // PC7
#define EEPROM_ADDR 0x50

void neuron_delay_nop(volatile uint32_t count) { while(count--) __asm__("nop"); }

void uart_init() {
    RCC->APB2PCENR |= (1 << 14);
    GPIOD->CFGLR &= ~((0xF << 20) | (0xF << 24));
    GPIOD->CFGLR |=  ((0x9 << 20) | (0x4 << 24));
    USART1->BRR = (48000000 + 115200 / 2) / 115200; 
    USART1->CTLR1 = (1 << 13) | (1 << 3) | (1 << 2); 
}
void uart_write(uint8_t data) { while (!(USART1->STATR & (1 << 7))); USART1->DATAR = data; }
void uart_print(const char* str) { while(*str) uart_write(*str++); }

void soft_i2c_start() {
    GPIOC->BSHR = (1 << SOFT_SDA); neuron_delay_nop(5);
    GPIOC->BSHR = (1 << SOFT_SCL); neuron_delay_nop(5);
    GPIOC->BSHR = (1 << (SOFT_SDA + 16)); neuron_delay_nop(5);
    GPIOC->BSHR = (1 << (SOFT_SCL + 16)); neuron_delay_nop(5);
}
void soft_i2c_stop() {
    GPIOC->BSHR = (1 << (SOFT_SDA + 16)); neuron_delay_nop(5);
    GPIOC->BSHR = (1 << SOFT_SCL); neuron_delay_nop(5);
    GPIOC->BSHR = (1 << SOFT_SDA);
}
void soft_i2c_write(uint8_t data) {
    for(int i=0; i<8; i++) {
        if(data & 0x80) GPIOC->BSHR = (1 << SOFT_SDA);
        else GPIOC->BSHR = (1 << (SOFT_SDA + 16));
        neuron_delay_nop(5);
        GPIOC->BSHR = (1 << SOFT_SCL); neuron_delay_nop(5);
        GPIOC->BSHR = (1 << (SOFT_SCL + 16));
        data <<= 1;
    }
    GPIOC->BSHR = (1 << SOFT_SDA); neuron_delay_nop(5);
    GPIOC->BSHR = (1 << SOFT_SCL); neuron_delay_nop(5);
    GPIOC->BSHR = (1 << (SOFT_SCL + 16));
}

void eeprom_write_byte(uint16_t addr, uint8_t data) {
    soft_i2c_start(); 
    soft_i2c_write((EEPROM_ADDR << 1) | 0);
    soft_i2c_write((uint8_t)(addr >> 8)); 
    soft_i2c_write((uint8_t)(addr & 0xFF));
    soft_i2c_write(data); 
    soft_i2c_stop(); 
    delay(5);
}

// Half-width Katakana 0xA1 (｡) to 0xDF (ﾟ) : 63 characters x 5 bytes
const uint8_t font_data_kana[63][5] = {
    {0x00, 0x00, 0x20, 0x50, 0x20}, // A1 ｡
    {0x00, 0x00, 0x78, 0x08, 0x08}, // A2 ｢
    {0x00, 0x00, 0x08, 0x08, 0x78}, // A3 ｣
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    {0x00, 0x1C, 0x22, 0x1C, 0x00}  // DF ﾟ
};

void setup() {
    RCC->APB2PCENR |= RCC_AFIOEN | RCC_IOPCEN | RCC_IOPDEN;
    GPIOC->CFGLR &= ~((0xF << 24) | (0xF << 28));
    GPIOC->CFGLR |=  ((0x5 << 24) | (0x5 << 28)); // PC6, PC7 Out
    
    uart_init();
    uart_print("\r\n--- Font Installer Phase 2 (Katakana) ---\r\n");
    uart_print("Starting EEPROM Write to 0x02DB...\r\n");

    uint16_t eeprom_addr = 0x02DB;
    
    for (int i = 0; i < 63; i++) {
        for (int j = 0; j < 5; j++) {
            eeprom_write_byte(eeprom_addr, font_data_kana[i][j]);
            eeprom_addr++;
        }
        if (i % 10 == 0) uart_print("."); // Progress dot
    }

    uart_print("\r\nWrite Complete! Katakana Installed.\r\n");
    uart_print("You can now flash the main OS (V0.27).\r\n");
}

void loop() {
    delay(1000);
}